/**
  **********************************************************************
  * @file    PID.c
  * @brief   位置式PID控制算法实现（含积分限幅、微分先行、输出偏移、
  *          输出限幅四项工程化改进）
  * @hardware 与具体硬件无关的纯算法模块，输入是目标值/测量值，
  *          输出交给main.c换算成电机PWM
  * @role    被main.c中的角度环/速度环/转向环三个PID_t实例共用，
  *          在TIM1的1ms中断里按节拍调用PID_Update完成闭环控制
  * @note    标准位置式PID公式（连续形式）：
  *            Out(t) = Kp*e(t) + Ki*∫e(t)dt + Kd*de(t)/dt
  *          离散化后（每个控制周期计算一次，k表示第k次）：
  *            Out(k) = Kp*e(k) + Ki*Σe(k) + Kd*[e(k)-e(k-1)]
  *          下面代码就是该公式的逐项实现，并做了防抖动/防饱和处理
  **********************************************************************
  */
#include "stm32f10x.h"                  // Device header
#include "PID.h"

/**
  * @brief  PID实例初始化（清零运行数据）
  * @param  p 指向要初始化的PID_t结构体的指针
  * @retval 无
  * @note   只清零目标、误差、各项输出等"运行量"；Kp/Ki/Kd、限幅值、
  *         偏移量等"参数"不在此设置（它们由main.c中的结构体初值给定）。
  *         改变运动状态（起步/转向/停止）时重新调用本函数，可把历史
  *         积分一并清零，避免旧积分影响新动作
  */
void PID_Init(PID_t *p)
{
	p->Target = 0;		//目标值清零
	p->Actual = 0;		//当前实际值清零
	p->Actual1 = 0;		//历史实际值清零
	p->Out = 0;			//输出清零
	p->Error0 = 0;		//当前误差清零
	p->Error1 = 0;		//历史误差清零
	p->POut = 0;		//P项清零
	p->IOut = 0;		//I项清零（含历史积分，清零可防止切换时积分残留）
	p->DOut = 0;		//D项清零
}

/**
  * @brief  执行一次位置式PID运算
  * @param  p 指向PID_t结构体的指针；调用前需填好p->Target和p->Actual，
  *           运算结果在p->Out中（POut/IOut/DOut也可单独观察调试）
  * @retval 无
  * @note   每10ms/50ms由中断周期调用一次，周期越短控制越及时，
  *         且Ki/Kd的数值与调用周期长短有关（本工程周期固定）
  */
void PID_Update(PID_t *p)
{
	/* 先把上一次的误差存档、再计算本次误差，结构体里始终同时保存 */
	/* "本次"和"上次"两个时刻的数据，供微分项做差使用 */
	/*误差传递*/
	p->Error1 = p->Error0;					//Error1←上一次的误差e(k-1)
	p->Error0 = p->Target - p->Actual;		//Error0←本次误差e(k)=目标值-实际值
											//正误差表示"实际还没达到目标"，需正向加力
	
	/* POut = Kp * e(k)，对应公式第一项：误差多大就按比例输出多大纠正力， */
	/* 是最主要的控制项；但只有P时通常会残留稳态误差（车斜一点时电机力矩 */
	/* 刚好等于重力，便不再动），需要I项来消除 */
	/*P项*/
	p->POut =  p->Kp * p->Error0;
	
	/* IOut += Ki * e(k)，即 IOut = Ki * Σe(k)，对应公式第二项： */
	/* 把每次误差累加，只要误差不为0积分就持续增长，产生额外输出消除稳态误差 */
	/*I项*/
	if (p->Ki != 0)
	{
		p->IOut +=  p->Ki * p->Error0;		//有积分系数时，历史积分继续累加
	}
	else
	{
		p->IOut = 0;						//Ki=0表示本环不用积分（如转向环），直接清零，
											//保证任何时候关闭积分都能立即生效、无残留
	}
	
	/* 抗积分饱和：把IOut限制在[OutMin, OutMax]内。为什么能防积分饱和： */
	/* 当输出已顶到极限（如路障挡车、误差长时间消不掉），积分仍会一直累 */
	/* 得很大；误差反向后过大的积分要很久才"偿还"完，表现为滞后、超调、 */
	/* 来回振荡。限幅后积分不超量，恢复时立刻可控 */
	/*积分限幅*/
	if (p->IOut > p->OutMax) {p->IOut = p->OutMax;}
	if (p->IOut < p->OutMin) {p->IOut = p->OutMin;}
	
	/* DOut = -Kd * (Actual - Actual1)，标准写法是对误差微分Kd*[e(k)-e(k-1)]， */
	/* 这里改为只对"实际测量值"微分：当目标值不变时，二者数学上完全等价 */
	/*（因 e(k)-e(k-1) = -(Actual-Actual1)）；而当目标突然跳变（遥控打杆、 */
	/* 速度环输出修改角度目标）时，对误差微分会因e瞬间跳变产生巨大尖峰，使 */
	/* 电机猛抖；对实际值微分则不受目标跳变影响，输出更平滑——这就是"微分 */
	/* 先行"防抖动的原因。Actual-Actual1是测量值的变化速度，D项相当于给 */
	/* "变化太快"的趋势踩刹车 */
	/*D项 + 微分先行*/
	p->DOut = - p->Kd * (p->Actual - p->Actual1);
	
	/* 三项相加，对应公式 Out = P + I + D */
	/*输出值*/
	p->Out = p->POut + p->IOut + p->DOut;
	
	/* 死区补偿：电机在PWM很小时力矩不足以克服静摩擦，给小指令也不转， */
	/* 这段不动作的范围叫"死区"；输出非零时同向叠加固定偏移，可让电机 */
	/* 立刻越过死区。不需要补偿的环把OutOffset设为0即可（速度/转向环为0） */
	/*输出偏移*/
	if (p->Out > 0) {p->Out += p->OutOffset;}
	if (p->Out < 0) {p->Out -= p->OutOffset;}
	
	/* 把最终输出限制在[OutMin, OutMax]内：①保护电机和驱动，PWM不超可执行 */
	/* 范围；②防止某个环输出过大把系统带飞（如角度环输出只允许±100） */
	/*输出限幅*/
	if (p->Out > p->OutMax) {p->Out = p->OutMax;}
	if (p->Out < p->OutMin) {p->Out = p->OutMin;}
	
	/* 把本次实际值存为"历史实际值"，供下一次微分先行做差使用 */
	/*实际值传递*/
	p->Actual1 = p->Actual;
}
